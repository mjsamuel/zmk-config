## config/west.yml
```yaml
manifest:
  remotes:
    - name: zmkfirmware # zmk official
      url-base: https://github.com/zmkfirmware
    - name: duckyb # kyek / duckyb
      url-base: https://github.com/duckyb
    - name: m165437 # nice-view-gem
      url-base: https://github.com/M165437
  projects:
    - name: zmk
      remote: zmkfirmware
      revision: v0.3
      import: app/west.yml
    - name: urchin-zmk-module
      remote: duckyb
      revision: main
    - name: nice-view-gem
      remote: m165437
      revision: v0.3.0
  self:
    path: config
```
