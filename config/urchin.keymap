#include <behaviors.dtsi>
#include <dt-bindings/zmk/bt.h>
#include <dt-bindings/zmk/keys.h>

// Layer definitions
#define DEFAULT 0
#define LOWER 1
#define RAISE 2
#define ADJUST 3

#define LEFT_HAND_KEYS 0 1 2 3 4 10 11 12 13 14 20 21 22 23 24
#define RIGHT_HAND_KEYS 5 6 7 8 9 15 16 17 18 19 25 26 27 28 29
#define THUMB_KEYS 30 31 32 33

#define HYPER LG(LC(LA(LSHIFT)))

#define HML(mod, key) &hrm_l mod key
#define HMR(mod, key) &hrm_r mod key

// If the key is tapped and then tapped again within this time, it will register
// as a the tap behaviour instead of the hold behaviour.
#define QUICK_TAP_MS 175

#define HRM_PROPS \
    compatible = "zmk,behavior-hold-tap"; \
    #binding-cells = <2>; \
    flavor = "balanced"; \
    hold-trigger-on-release; \
    quick-tap-ms = <QUICK_TAP_MS>; \
    tapping-term-ms = <280>; \
    require-prior-idle-ms = <150>; \
    bindings = <&kp>, <&kp>;

#define COMBO_PROPS \
    timeout-ms = <55>; \
    require-prior-idle-ms = <125>; \
    layers = <DEFAULT>;

&mt {
    quick-tap-ms = <QUICK_TAP_MS>;
};

/ {
    combos {
        compatible = "zmk,combos";

        combo_alt_tab {
            bindings = <&kp LA(TAB)>;
            key-positions = <12 13>;
            COMBO_PROPS
        };

        combo_escape {
            bindings = <&kp ESC>;
            key-positions = <11 12>;
            COMBO_PROPS
        };

        combo_left_bracket {
            bindings = <&kp LBKT>;
            key-positions = <7 6>;
            COMBO_PROPS
        };

        combo_right_bracket {
            bindings = <&kp RBKT>;
            key-positions = <7 8>;
            COMBO_PROPS
        };

        combo_left_paren {
            bindings = <&kp LPAR>;
            key-positions = <17 16>;
            COMBO_PROPS
        };

        combo_right_paren {
            bindings = <&kp RPAR>;
            key-positions = <17 18>;
            COMBO_PROPS
        };

        combo_quote {
            bindings = <&kp SQT>;
            key-positions = <26 27>;
            COMBO_PROPS
        };
    };

    macros {
        quick_lock: quick_lock {
            compatible = "zmk,behavior-macro";
            label = "QUICK_LOCK";
            #binding-cells = <0>;
            bindings = <&kp LG(LC(Q)) &kp ESCAPE>;
            wait-ms = <100>;
        };
    };

    behaviors {
        hrm_l: left_homerow_mods {
            label = "HOMEROW_MODS_LEFT";
            hold-trigger-key-positions = <RIGHT_HAND_KEYS THUMB_KEYS>;
            HRM_PROPS
        };

        hrm_r: right_homerow_mods {
            label = "HOMEROW_MODS_RIGHT";
            hold-trigger-key-positions = <LEFT_HAND_KEYS THUMB_KEYS> ;
            HRM_PROPS
        };
    };

    keymap {
        compatible = "zmk,keymap";

        default_layer {
            label = "DEFAULT";
            bindings = <
&kp Q          &kp W          &kp F         &kp P          &kp G          &kp J           &kp L          &kp U         &kp Y          &kp SEMI
HML(LSHFT, A)  HML(LCTRL, R)  HML(LALT, S)  HML(LGUI, T)   HML(HYPER, D)  HMR(HYPER, H)   HMR(LGUI, N)   HMR(LALT, E)  HMR(LCTRL, I)  HMR(LSHFT, O)
&kp Z          &kp X          &kp C         &kp V          &kp B          &kp K           &kp M          &kp COMMA     &kp DOT        &kp SLASH
                                            &lt LOWER RET  &kp SPACE      &mt LSHFT BSPC  &lt RAISE TAB
            >;
        };

        LOWER {
            label = "LOWER";
            bindings = <
&trans  &kp F1          &kp F2         &kp F3         &trans  &kp DOWN  &kp RIGHT       &trans          &trans           &trans
&trans  HML(LCTRL, F4)  HML(LALT, F5)  HML(LGUI, F6)  &trans  &kp LEFT  HMR(LGUI, F10)  HMR(LALT, F11)  HMR(LCTRL, F12)  &trans
&trans  &kp F7          &kp F8         &kp F9         &trans  &kp UP    &trans          &trans          &trans           &trans
                                       &trans         &trans  &trans    &trans
            >;
        };

        RAISE {
            label = "RAISE";
            bindings = <
&kp N0             &kp N1          &kp N2         &kp N3         &kp AMPS          &kp BSLH           &kp AT            &kp STAR         &kp CARET          &kp DLLR
HML(LSHFT, PRCNT)  HML(LCTRL, N4)  HML(LALT, N5)  HML(LGUI, N6)  HML(HYPER, PIPE)  HMR(HYPER, TILDE)  HMR(LGUI, MINUS)  HMR(LALT, PLUS)  HMR(LCTRL, EQUAL)  HMR(LSHFT, GRAVE)
&kp HASH           &kp N7          &kp N8         &kp N9         &kp EXCL          &kp UNDER          &trans            &trans           &trans             &trans
                                                  &trans         &trans            &trans             &trans
            >;
        };

        ADJUST {
            label = "ADJUST";
            bindings = <
&quick_lock  &trans  &trans      &trans            &bt BT_SEL 0  &bt BT_SEL 3  &kp C_BRI_DEC  &kp C_BRI_INC  &trans  &trans
&trans       &trans  &kp C_MUTE  &kp C_PLAY_PAUSE  &bt BT_SEL 1  &bt BT_SEL 4  &kp C_VOL_DN   &kp C_VOL_UP   &trans  &trans
&trans       &trans  &trans      &trans            &bt BT_SEL 2  &bt BT_CLR    &trans         &trans         &trans  &trans
                                 &trans            &trans        &trans        &trans
            >;
        };
    };

    conditional_layers {
        compatible = "zmk,conditional-layers";

        tri_layer {
            if-layers = <LOWER RAISE>;
            then-layer = <ADJUST>;
        };
    };
};
